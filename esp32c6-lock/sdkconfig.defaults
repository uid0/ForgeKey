## esp32c6-lock/sdkconfig.defaults
```kconfig
# ESP32-C6 Lock Device - SDK config defaults

# WiFi
CONFIG_ESP_WIFI_SSID="ForgeKey-Setup-XXXX"
CONFIG_ESP_WIFI_PASSWORD="12345678"
CONFIG_ESP_WIFI_AUTH_MODE=WIFI_AUTH_WPA2_PSK
CONFIG_ESP_WIFI_MAX_RETRY_CNT=15
CONFIG_ESP_WIFI_MBEDTLS_CRYPTO=y
CONFIG_ESP_WIFI_WPA3_OWE_SUPPORT=y

# MQTT
CONFIG_MQTT_PROTOCOL_3_1_1=y
CONFIG_MQTT_TRANSPORT_SSL=y
CONFIG_MQTT_SSL_HEART_BEAT=y
CONFIG_MQTT_NETWORK_TIMEOUT_MS=10000
CONFIG_MQTT_TCP_PORT=8883
CONFIG_MQTT_WS_PORT=80

# HTTP/HTTPS
CONFIG_HTTPD_MAX_REQ_HDR_LEN=1024
CONFIG_HTTPD_MAX_URI_LEN=512
CONFIG_HTTPS_CERTIFICATE_BUNDLE=y
CONFIG_HTTPS_CERTIFICATE_BUNDLE_DEFAULT_FULL=y
CONFIG_ESP_TLS_USE_SECURE_ELEMENT=y
CONFIG_ESP_TLS_USEMBEDTLS_CERT=y

# OTA
CONFIG_ESP_HTTPS_OTA_ALLOW_HTTP=y
CONFIG_ESP_HTTPS_OTA_ALLOW_HTTPS=y
CONFIG_ESP_OTA_OPTIMIZED_TO_ROOT_FS=y

# NVS
CONFIG_NVS_FLASH_PAGE_CHECK=y
CONFIG_NVS_ENCRYPTION=y
CONFIG_NVS_SUPPORT_UTF8=y

# General
CONFIG_FREERTOS_HZ=1000
CONFIG_ESP_TASK_WDT_TIMEOUT_S=30
CONFIG_ESP_TASK_WDT_CHECK_IDLE_TASK_CPU0=y
CONFIG_ESP_TASK_WDT_CHECK_IDLE_TASK_CPU1=y
CONFIG_ESP_SYSTEM_PANIC_PRINT_REBOOT=y
CONFIG_LOG_DEFAULT_LEVEL=3
CONFIG_LOG_DEFAULT_LEVEL_ERROR=y
CONFIG_LOG_COLORS=y
CONFIG_ESP_SYSTEM_EVENT_QUEUE_SIZE=32
CONFIG_ESP_SYSTEM_EVENT_TASK_STACK_SIZE=2304
CONFIG_ESP_MAIN_TASK_STACK_SIZE=3584
CONFIG_ESP_MAIN_TASK_AFFINITY_CPU0=y

# ESP-IDF v5.x specific
CONFIG_ESP_SYSTEM_WEAK_TASK_STACK_SIZE=2048
CONFIG_LWIP_LOCAL_HOSTNAME="ForgeKey-Lock"
```
