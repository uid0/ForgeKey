## esp32c6-lock/main/Kconfig.projbuild
```kconfig
# ESP32-C6 Lock Device - Kconfig options

config FORGEKEY_LOCK_SOLENOID_PIN
    int "Solenoid control pin"
    default 0
    help
        GPIO pin for solenoid MOSFET control.

config FORGEKEY_LOCK_REED_PIN
    int "Reed switch pin"
    default 1
    help
        GPIO pin for reed switch (door closed sensor).

config FORGEKEY_LOCK_MORTISE_PIN
    int "Mortise switch pin"
    default 5
    help
        GPIO pin for mortise (physical key) switch.

config FORGEKEY_LOCK_LATCH_SUPERVISOR_PIN
    int "Latch supervisor pin"
    default 6
    help
        GPIO pin for latch bolt position sensor.

config FORGEKEY_LOCK_IR_BEAM_PIN
    int "IR breakbeam pin"
    default 4
    help
        GPIO pin for IR breakbeam receiver.

config FORGEKEY_LOCK_SOLENOID_PULSE_MS
    int "Solenoid pulse duration (ms)"
    default 1500
    help
        Duration of solenoid unlock pulse in milliseconds.

config FORGEKEY_LOCK_STATUS_LED_PIN
    int "Optional status LED pin"
    default -1
    help
        Optional GPIO pin for lockout/tamper/commissioning local status LED.
        Set to -1 to disable LED output.

config FORGEKEY_LOCK_LOCKOUT_FLASH_MS
    int "Lockout LED flash interval (ms)"
    default 100
    help
        Fast blink interval used while operator lockout is active.

config FORGEKEY_LOCK_COMMISSION_FLASH_MS
    int "Commissioning LED flash interval (ms)"
    default 700
    help
        Slow blink interval used while commissioning mode is active.

config FORGEKEY_LOCK_BATTERY_ADC_PIN
    int "Optional battery ADC pin"
    default -1
    help
        ADC-capable GPIO connected to a battery divider. Set to -1 when absent.

config FORGEKEY_LOCK_BATTERY_DIVIDER_NUM
    int "Battery divider numerator"
    default 2

config FORGEKEY_LOCK_BATTERY_DIVIDER_DEN
    int "Battery divider denominator"
    default 1

config FORGEKEY_LOCK_BATTERY_EMPTY_MV
    int "Battery empty millivolts"
    default 3300

config FORGEKEY_LOCK_BATTERY_FULL_MV
    int "Battery full millivolts"
    default 4200

config FORGEKEY_LOCK_BATTERY_LOW_MV
    int "Low battery alarm millivolts"
    default 3450

config FORGEKEY_LOCK_TELEMETRY_INTERVAL_MS
    int "Telemetry publish interval (ms)"
    default 10000
    help
        Interval between telemetry publishes in milliseconds.

config FORGEKEY_LOCK_CMD_TIMESTAMP_TOLERANCE_S
    int "Command timestamp tolerance (seconds)"
    default 60
    help
        Maximum allowed time difference for command timestamps.

config FORGEKEY_LOCK_JWT_EXPIRY_S
    int "Signed-command expiry window (seconds)"
    default 30
    help
        Maximum signed-command expiry time in seconds.

config FORGEKEY_LOCK_WEB_PORT
    int "Embedded web server port"
    default 80
    help
        HTTP port for embedded status page.

config FORGEKEY_SENSOR_KIND
    string "Sensor kind for OMS enrollment"
    default "cabinet-lock"
    help
        Sensor kind sent to OMS during device enrollment.

config FORGEKEY_MQTT_TOPIC_KIND
    string "MQTT topic kind segment"
    default "cabinet_lock"
    help
        MQTT topic kind segment for this device type.

config FORGEKEY_PRODUCTION_SECURITY
    bool "Enable ForgeKey production security profile"
    default n
    help
        Store provisioning artifacts in the encrypted NVS partition and assume
        manufacturing has enabled secure boot, flash encryption, and debug-port
        lock-down eFuses.
```
